## conf/layer.conf
```bitbake
# We have a conf and classes directory, add to BBPATH
BBPATH .= ":${LAYERDIR}"

# We have recipes-* directories, add to BBFILES
BBFILES += "${LAYERDIR}/recipes-*/*/*.bb \
            ${LAYERDIR}/recipes-*/*/*.bbappend"

BBFILE_COLLECTIONS += "meta-semo"
BBFILE_PATTERN_meta-semo = "^${LAYERDIR}/"
BBFILE_PRIORITY_meta-semo = "6"

LAYERSERIES_COMPAT_meta-semo = "sumo"
```
